## esp32c3/idf/motor/Kconfig
```kconfig
config TRINITY_MODE_BENCH
    bool "Trinity bench mode — halt on crash for USB-JTAG attach"
    default n
    help
      When enabled, panic handler halts in an infinite loop.
      Attach ESP32-C3 USB-JTAG debugger to inspect state.
      Use this mode on the dev bench only.

config TRINITY_MODE_USB
    bool "Trinity USB mode — USB CDC log transport + restart"
    default n
    help
      When enabled, console output goes to USB CDC serial.
      Panic handler logs to NVS and calls esp_restart().
      Use when device is USB-tethered for field testing.
```

## esp32c3/zephyr/pir/build_test/Kconfig/arch/Kconfig
```kconfig
# Load Zephyr Arch Kconfig descriptions.
osource "/home/hailviral-server/zephyrproject/zephyr/arch/rx/Kconfig"
osource "/home/hailviral-server/zephyrproject/zephyr/arch/x86/Kconfig"
osource "/home/hailviral-server/zephyrproject/zephyr/arch/xtensa/Kconfig"
osource "/home/hailviral-server/zephyrproject/zephyr/arch/sparc/Kconfig"
osource "/home/hailviral-server/zephyrproject/zephyr/arch/riscv/Kconfig"
osource "/home/hailviral-server/zephyrproject/zephyr/arch/posix/Kconfig"
osource "/home/hailviral-server/zephyrproject/zephyr/arch/mips/Kconfig"
osource "/home/hailviral-server/zephyrproject/zephyr/arch/arm64/Kconfig"
osource "/home/hailviral-server/zephyrproject/zephyr/arch/arm/Kconfig"
osource "/home/hailviral-server/zephyrproject/zephyr/arch/arc/Kconfig"
```

## nrf52840/reed-sensor/build_test/Kconfig/boards/Kconfig
```kconfig
# Load Zephyr board Kconfig descriptions.
osource "/home/hailviral-server/zephyrproject/zephyr/boards/native/native_sim/Kconfig"
```

## nrf52840/smart-light/build_test/Kconfig/boards/Kconfig.defconfig
```kconfig
# Load Zephyr board defconfig descriptions.
osource "/home/hailviral-server/zephyrproject/zephyr/boards/native/native_sim/Kconfig.defconfig"
```

## nrf52840/smart-light/build_test/Kconfig/boards/Kconfig.sysbuild
```kconfig
# Load Sysbuild board Kconfig descriptions.
osource "/home/hailviral-server/zephyrproject/zephyr/boards/native/native_sim/Kconfig.sysbuild"
```
