## prj.conf
```kconfig
# 1. Enable RTT Console and Logging
CONFIG_USE_SEGGER_RTT=y
CONFIG_RTT_CONSOLE=y
CONFIG_LOG_BACKEND_RTT=y
CONFIG_CONSOLE=y
CONFIG_SERIAL=y  # RTT is technically a serial device

# 2. Disable the UART-based console
CONFIG_UART_CONSOLE=n
CONFIG_UART_INTERRUPT_DRIVEN=n
CONFIG_LOG_BACKEND_UART=n

CONFIG_LOG=y
CONFIG_PRINTK=y
CONFIG_DEBUG=y

CONFIG_BUILD_OUTPUT_UF2=y

# Disable unused hardware
CONFIG_USB_DEVICE_STACK=n
CONFIG_USB_DEVICE_STACK_NEXT=n
CONFIG_USB_CDC_ACM=n
```

## src/battery.h
```c
#pragma once

int battery_init(void);
int battery_read_mv(void);
void battery_print_status(void);
```

## src/build_info.c
```c
#include <zephyr/kernel.h>

__attribute__((used, retain, section(".rodata"))) 
const char trinity_build_mode[] = "TRINITY_BUILD_MODE=" CONFIG_TRINITY_MODE_STR;

__attribute__((used, retain, section(".rodata"))) 
const char trinity_build_date[] = "TRINITY_BUILD_DATE=" __DATE__ " " __TIME__;
```
