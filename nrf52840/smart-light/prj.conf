## CMakeLists.txt
```
cmake_minimum_required(VERSION 3.20.0)
find_package(Zephyr REQUIRED HINTS $ENV{ZEPHYR_BASE})
project(smartlight_service)
target_sources(app PRIVATE
    src/main.c
    src/relay.c
    src/light_hw_zephyr.c
    src/ble_gatt.c
    src/build_info.c
    src/trinity_wdt.c
    src/trinity_canary.c
    src/trinity_flash.c
    src/trinity_stats.c
    src/trinity_fault.c
    src/trinity_boot.c
)

target_include_directories(app PRIVATE
    ../../include
)
```

## prj.conf
```kconfig
# /******************************************************************************
# * \file prj.conf
# * \author MichaelLynnCSU (https://github.com/MichaelLynnCSU)
# * \date    01-01-2025
# *
# * \brief   Zephyr project configuration for nRF52840 smart light node.
# *
# * \details Enables GPIO, UART console, deferred logging, BLE peripheral,
# *          flash storage, UF2 build output, stack sentinel, and heap
# *          checking for trinity fault coverage.
# *
# *          Trinity build mode is selected at west build time:
# *            BENCH: west build -- -DCONFIG_TRINITY_MODE_BENCH=y
# *            FIELD: west build (default — no extra flag needed)
# ******************************************************************************/

CONFIG_TRINITY_CHIP_NRF52840=y
# ========================= CORE PERIPHERALS ==================================
CONFIG_GPIO=y
CONFIG_PRINTK=y

# ========================= CONSOLE / UART ====================================
CONFIG_CONSOLE=y
CONFIG_UART_CONSOLE=y
CONFIG_UART_INTERRUPT_DRIVEN=y

# ========================= LOGGING ===========================================
CONFIG_LOG=y
CONFIG_LOG_BACKEND_UART=y
CONFIG_LOG_MODE_DEFERRED=y
CONFIG_LOG_DEFAULT_LEVEL=3
CONFIG_LOG_BUFFER_SIZE=16384
CONFIG_LOG_PROCESS_THREAD_STACK_SIZE=1024
CONFIG_BT_LOG_LEVEL_OFF=y

# ========================= BLUETOOTH =========================================
CONFIG_BT=y
CONFIG_BT_PERIPHERAL=y
CONFIG_BT_BROADCASTER=y
CONFIG_BT_OBSERVER=y
CONFIG_BT_SMP=y
CONFIG_BT_PRIVACY=n
CONFIG_BT_GATT_SERVICE_CHANGED=n
CONFIG_BT_DEVICE_NAME="LightNF"

# ========================= FLASH STORAGE =====================================
CONFIG_FLASH=y
CONFIG_FLASH_MAP=y
CONFIG_FLASH_PAGE_LAYOUT=y
CONFIG_MPU_ALLOW_FLASH_WRITE=y
CONFIG_STREAM_FLASH=y

# ========================= BUILD OUTPUT ======================================
CONFIG_BUILD_OUTPUT_UF2=y

# ========================= PERSISTENT SETTINGS ===============================
CONFIG_BT_SETTINGS=y
CONFIG_NVS=y
CONFIG_SETTINGS=y
CONFIG_SETTINGS_NVS=y

# ========================= FAULT COVERAGE ====================================
CONFIG_REBOOT=y
CONFIG_FAULT_DUMP=2
CONFIG_FRAME_POINTER=y
CONFIG_HW_STACK_PROTECTION=y
CONFIG_HEAP_MEM_POOL_IGNORE_MIN=y
CONFIG_THREAD_STACK_INFO=y
CONFIG_THREAD_NAME=y
CONFIG_INIT_STACKS=y

# ========================= RADIO / FLASH SYNC ================================
# driver's internal serialization semaphore, causing nrf_nvmc_ready_check()
# panics when Trinity's write_entry() on sysworkq raced with BLE stack
# settings saves on BT RX WQ. Confirmed crash: PC=0x5954494E ("NITY"),
# SP=0x003BA538. Replaced with TICKER which serializes all flash callers
# (Trinity, BLE bonding, NVS settings) at the driver level via sem_lock.
# PARTIAL_ERASE added to reduce BLE radio interference during flash erase.
CONFIG_SOC_FLASH_NRF_RADIO_SYNC_TICKER=y
CONFIG_SOC_FLASH_NRF_PARTIAL_ERASE=y

# ========================= TRINITY WATCHDOG ==================================
CONFIG_WATCHDOG=y
CONFIG_WDT_DISABLE_AT_BOOT=n

# ========================= TRINITY HEAP STATS ================================
CONFIG_SYS_HEAP_RUNTIME_STATS=y
CONFIG_HEAP_MEM_POOL_SIZE=4096
CONFIG_HEAP_MEM_POOL_IGNORE_MIN=y

# ========================= TRINITY THREAD STATS ==============================
CONFIG_THREAD_ANALYZER=y
CONFIG_THREAD_ANALYZER_USE_PRINTK=n
CONFIG_THREAD_ANALYZER_AUTO=n
CONFIG_THREAD_RUNTIME_STATS=y

# ========================= STACK SIZES =======================================
CONFIG_SYSTEM_WORKQUEUE_STACK_SIZE=3072
CONFIG_MAIN_STACK_SIZE=2048
CONFIG_ISR_STACK_SIZE=4096
CONFIG_LOG_PROCESS_THREAD_STACK_SIZE=1024
CONFIG_BOOT_DELAY=2000
```

## boards/bench.conf
```kconfig
# Bench mode — RTT logging, no UART, no USB
CONFIG_UART_CONSOLE=n
CONFIG_UART_INTERRUPT_DRIVEN=n
CONFIG_LOG_BACKEND_UART=n
CONFIG_CONSOLE=y
CONFIG_RTT_CONSOLE=y
CONFIG_STDOUT_CONSOLE=y
CONFIG_LOG_BACKEND_RTT=y
CONFIG_USE_SEGGER_RTT=y
CONFIG_SEGGER_RTT_BUFFER_SIZE_UP=4096
CONFIG_LOG_BACKEND_RTT_MODE_DROP=y
CONFIG_USB_DEVICE_STACK_NEXT=n
CONFIG_USBD_CDC_ACM_CLASS=n
# WDT cannot be disabled on nRF52840 — wdt_nrf_disable() returns -EPERM
# because NRFX_WDT_HAS_STOP is not defined for this chip. The line below
# is a no-op but kept for documentation. trinity_wdt_init() feeds channel 0
# in bench mode so the bootloader-armed WDT does not fire.
CONFIG_WDT_DISABLE_AT_BOOT=y
CONFIG_WATCHDOG=y
```

## src/main.c
```c
/******************************************************************************
 * \file    main.c
 * \author  MichaelLynnCSU (https://github.com/MichaelLynnCSU)
 * \date    01-01-2025
 *
 * \brief   nRF52840 smart light relay controller entry point.
 *
 * \note    settings_load() fix (2026-03-24):
 *          Called after bt_enable() in ble_gatt_init() so BLE stack has
 *          a valid identity address and bt_le_adv_start() does not hang.
 *
 * \note    Init stage cookie (2026-03-24):
 *          g_init_stage breadcrumbs written before each risky init call.
 *          Printed alongside PRE_INIT_CRASH to narrow crash to one call.
 *
 * \note    WDT boot fix (2026-03-24):
 *          trinity_wdt_kick() added after bt_enable() and settings_load()
 *          inside ble_gatt_init() to prevent WDT firing during boot.
 *
 * \note    Flash concurrency fix (2026-03-24):
 *          write_light_control() calls trinity_log_event() which acquires
 *          the flash mutex internally -- no external lock needed.
 *
 * \note    RESETREAS clear fix (2026-03-27):
 *          RESETREAS read and cleared at very top of main() before any
 *          other code runs. Latched OR-history register -- must be
 *          explicitly cleared to prevent stale bits surviving across boots.
 *
 * \note    GPIO seam (2026-05-xx):
 *          All GPIO access moved to light_hw_zephyr.c behind light_hw.h.
 *          main.c has no GPIO or devicetree dependency.
 *          relay_set() is a thin wrapper over light_hw_set() so ble_gatt.c
 *          calling relay_set() requires no changes.
 ******************************************************************************/

#include <zephyr/kernel.h>
#include <zephyr/sys/printk.h>
#include <nrf.h>
#include "light_hw.h"
#include "ble_gatt.h"
#include "trinity_log.h"
#include "main.h"

int main(void)
{
    int      err          = 0;
    uint32_t reset_reason = 0;

    reset_reason         = NRF_POWER->RESETREAS;
    NRF_POWER->RESETREAS = 0xFFFFFFFF;

#if !defined(CONFIG_TRINITY_MODE_BENCH)
    g_init_stage = TRINITY_STAGE_WDT_INIT;
    trinity_wdt_init();
    trinity_wdt_kick();
#endif

    printk("\n=== LightNF BLE Relay Controller ===\n");

    trinity_log_dump_previous();

    g_init_stage = TRINITY_STAGE_GPIO;
    err = light_hw_init();
    if (0 != err) { return err; }

    g_init_stage = TRINITY_STAGE_LOG_INIT;
    if (trinity_log_init() == 0)
    {
        trinity_log_boot_reason(reset_reason);
    }
    trinity_wdt_kick();

    trinity_log_dump_previous_deferred();

#if defined(CONFIG_TRINITY_MODE_BENCH)
    g_init_stage = TRINITY_STAGE_WDT_INIT;
    trinity_wdt_init();
    trinity_wdt_kick();
#endif

    g_init_stage = TRINITY_STAGE_BT_ENABLE;
    err = ble_gatt_init();
    if (0 != err) { return err; }

    g_init_stage = TRINITY_STAGE_MAIN_LOOP;

    while (1)
    {
        trinity_wdt_kick();
        k_sleep(K_MSEC(2000));
    }

    return 0;
}
```

## src/ble_gatt.c
```c
/******************************************************************************
 * \file    ble_gatt.c
 * \author  MichaelLynnCSU (https://github.com/MichaelLynnCSU)
 * \date    01-01-2025
 *
 * \brief   BLE GATT service and advertising for nRF52840 smart light node.
 *
 * \details Connectable BLE peripheral. Exposes a light control
 *          characteristic (read/write) and a heartbeat characteristic
 *          (read/notify). Advertisement carries manufacturer data with
 *          current light state for passive hub BLE scanning.
 *
 *          GATT layout:
 *          Service  0xABCD
 *            Char   0xAB01  light control  R/W/WWR
 *            Char   0xAB02  heartbeat      R/Notify
 *            CCC
 *
 * \note    adv restart fix (2026-03-24):
 *          restart_advertising() uses a delayable work item on retry so
 *          sysworkq is never blocked for 1s on the retry path.
 *
 * \note    Flash concurrency fix (2026-03-24):
 *          write_light_control() calls trinity_log_event() which acquires
 *          the flash mutex internally -- no external lock needed.
 *
 * \note    settings_load() fix (2026-03-24):
 *          Called after bt_enable() so BLE stack has a valid identity
 *          address and bt_le_adv_start() does not hang.
 *
 * \note    Structured event tracing -- tx_id (2026-06-16):
 *          write_light_control() now accepts a 3-byte payload:
 *          [state:1][tx_id_lo:1][tx_id_hi:1]. tx_id is extracted and
 *          logged alongside state. Old 1-byte writes produce tx_id=0
 *          (graceful degradation via LIGHT_WRITE_LEN guard).
 *
 *          tx_id is a per-session command counter (RAM only on hub).
 *          Correlation key is (MAC + tx_id) within a bounded time window.
 *          It is NOT a global unique message ID.
 *
 *          Two-phase identity (see main.h layout comment):
 *          Device logs tx_id only. Hub logs tx_id + event_id mapping.
 ******************************************************************************/

#include "ble_gatt.h"
#include "main.h"
#include "trinity_log.h"
#include <zephyr/kernel.h>
#include <zephyr/bluetooth/bluetooth.h>
#include <zephyr/bluetooth/conn.h>
#include <zephyr/bluetooth/gatt.h>
#include <zephyr/bluetooth/uuid.h>
#include <zephyr/settings/settings.h>
#include <zephyr/sys/printk.h>
#include <string.h>

#define BT_UUID_LIGHT_SERVICE   BT_UUID_DECLARE_16(0xABCD)
#define BT_UUID_LIGHT_CONTROL   BT_UUID_DECLARE_16(0xAB01)

static uint8_t  light_state        = 0;
static uint8_t  heartbeat_val      = 1;
static uint64_t last_activity_time = 0;

static const struct bt_gatt_attr *heartbeat_attr = NULL;
static struct bt_conn            *current_conn   = NULL;

static uint8_t light_mfg_data[MFG_DATA_SIZE] = {MFG_COMPANY_ID, 0x00, 0x00};
static uint8_t light_heartbeat_counter = 0; /**< written into
                                              *   light_mfg_data[MFG_HEARTBEAT_IDX] */

static struct bt_data adv_data[] =
{
    BT_DATA_BYTES(BT_DATA_FLAGS, BT_LE_AD_GENERAL | BT_LE_AD_NO_BREDR),
    BT_DATA_BYTES(BT_DATA_NAME_COMPLETE, 'L','i','g','h','t','N','F'),
    BT_DATA(BT_DATA_MANUFACTURER_DATA, light_mfg_data, sizeof(light_mfg_data)),
};

/*----------------------------------------------------------------------------*/

void ble_adv_update(void)
{
    light_mfg_data[MFG_STATE_IDX]     = light_state;
    light_mfg_data[MFG_HEARTBEAT_IDX] = light_heartbeat_counter;
    bt_le_adv_update_data(adv_data, ARRAY_SIZE(adv_data), NULL, 0);
}

/*----------------------------------------------------------------------------*/

static struct k_work_delayable adv_restart_dwork;

static void restart_advertising(struct k_work *work)
{
    int err = bt_le_adv_start(BT_LE_ADV_CONN_FAST_1,
                               adv_data, ARRAY_SIZE(adv_data), NULL, 0);
    if (0 != err)
    {
        printk("[BLE] Adv restart failed: %d, retrying in 1s\n", err);
        k_work_reschedule(&adv_restart_dwork, K_MSEC(1000));
    }
    else
    {
        printk("[BLE] Advertising restarted\n");
    }
}

/*----------------------------------------------------------------------------*/

static struct k_work hb_work;

static void hb_work_handler(struct k_work *work)
{
    uint64_t now = k_uptime_get();

    if ((now - last_activity_time) > (IDLE_HEARTBEAT_SEC * 1000ULL))
    {
        light_heartbeat_counter++;
        ble_adv_update();
        if (current_conn && heartbeat_attr)
        {
            heartbeat_val = 1;
            int err = bt_gatt_notify(current_conn, heartbeat_attr,
                                     &heartbeat_val, sizeof(heartbeat_val));
            if (err && err != -ENOTCONN)
            {
                printk("[HB] Notify failed: %d\n", err);
            }
        }
        last_activity_time = k_uptime_get();
        printk("[HB] Sent\n");
    }
}

static void idle_hb_handler(struct k_timer *timer) { k_work_submit(&hb_work); }
K_TIMER_DEFINE(idle_hb_timer, idle_hb_handler, NULL);

/*----------------------------------------------------------------------------*/

static struct k_work stats_work;

static void stats_work_handler(struct k_work *work)
{
    trinity_wdt_kick();
    trinity_log_heap_stats();
    trinity_log_task_stats();
}

static void stats_timer_handler(struct k_timer *timer) { k_work_submit(&stats_work); }
K_TIMER_DEFINE(stats_timer, stats_timer_handler, NULL);

/*----------------------------------------------------------------------------*/

static ssize_t write_light_control(struct bt_conn *conn,
                                    const struct bt_gatt_attr *attr,
                                    const void *buf, uint16_t len,
                                    uint16_t offset, uint8_t flags)
{
    const uint8_t *p_buf   = (const uint8_t *)buf;
    uint8_t        new_state = 0;
    uint16_t       tx_id    = 0; /**< hub-stamped command counter;
                                  *   0 = old hub firmware, 1-byte write */

    if (LIGHT_WRITE_LEN != len)
    {
        return BT_GATT_ERR(BT_ATT_ERR_INVALID_ATTRIBUTE_LEN);
    }

    new_state = p_buf[LIGHT_WRITE_STATE_IDX];

    if (new_state > LIGHT_STATE_MAX)
    {
        return BT_GATT_ERR(BT_ATT_ERR_VALUE_NOT_ALLOWED);
    }

    tx_id = (uint16_t)p_buf[LIGHT_WRITE_TX_ID_LO_IDX] |
            ((uint16_t)p_buf[LIGHT_WRITE_TX_ID_HI_IDX] << 8);

    light_state        = new_state;
    last_activity_time = k_uptime_get();

    relay_set(light_state);
    ble_adv_update();

    printk("[LIGHT] tx_id=%u state=%s\n",
           (unsigned)tx_id, light_state ? "ON" : "OFF");
    trinity_log_event(light_state ? "EVENT: LIGHT_ON\n" : "EVENT: LIGHT_OFF\n");

    return len;
}

static ssize_t read_light_control(struct bt_conn *conn,
                                   const struct bt_gatt_attr *attr,
                                   void *buf, uint16_t len, uint16_t offset)
{
    return bt_gatt_attr_read(conn, attr, buf, len, offset,
                             &light_state, sizeof(light_state));
}

static ssize_t read_heartbeat(struct bt_conn *conn,
                               const struct bt_gatt_attr *attr,
                               void *buf, uint16_t len, uint16_t offset)
{
    return bt_gatt_attr_read(conn, attr, buf, len, offset,
                             &heartbeat_val, sizeof(heartbeat_val));
}

BT_GATT_SERVICE_DEFINE(light_svc,
    BT_GATT_PRIMARY_SERVICE(BT_UUID_LIGHT_SERVICE),
    BT_GATT_CHARACTERISTIC(
        BT_UUID_LIGHT_CONTROL,
        BT_GATT_CHRC_READ | BT_GATT_CHRC_WRITE | BT_GATT_CHRC_WRITE_WITHOUT_RESP,
        BT_GATT_PERM_READ | BT_GATT_PERM_WRITE,
        read_light_control, write_light_control, &light_state),
    BT_GATT_CHARACTERISTIC(
        BT_UUID_DECLARE_16(0xAB02),
        BT_GATT_CHRC_READ | BT_GATT_CHRC_NOTIFY,
        BT_GATT_PERM_READ,
        read_heartbeat, NULL, &heartbeat_val),
    BT_GATT_CCC(NULL, BT_GATT_PERM_READ | BT_GATT_PERM_WRITE),
);

/*----------------------------------------------------------------------------*/

static void connected(struct bt_conn *conn, uint8_t err)
{
    char addr[BT_ADDR_LE_STR_LEN];
    struct bt_le_conn_param param =
    {
        .interval_min = 24, .interval_max = 40,
        .latency = 0, .timeout = 400
    };

    bt_addr_le_to_str(bt_conn_get_dst(conn), addr, sizeof(addr));

    if (0 != err)
    {
        printk("[BLE] Connection failed to %s: %d\n", addr, err);
        return;
    }

    if (current_conn && current_conn != conn)
    {
        bt_conn_disconnect(current_conn, BT_HCI_ERR_REMOTE_USER_TERM_CONN);
        bt_conn_unref(current_conn);
    }

    current_conn = bt_conn_ref(conn);
    printk("[BLE] Connected to %s\n", addr);
    trinity_log_event("EVENT: BLE_CONNECTED\n");

    bt_conn_le_param_update(conn, &param);
    last_activity_time = k_uptime_get();
}

static void disconnected(struct bt_conn *conn, uint8_t reason)
{
    char addr[BT_ADDR_LE_STR_LEN];

    bt_addr_le_to_str(bt_conn_get_dst(conn), addr, sizeof(addr));
    printk("[BLE] Disconnected from %s (reason: %d)\n", addr, reason);
    trinity_log_event("EVENT: BLE_DISCONNECTED\n");

    if (current_conn == conn)
    {
        bt_conn_unref(current_conn);
        current_conn = NULL;
    }

    k_work_reschedule(&adv_restart_dwork, K_NO_WAIT);
}

BT_CONN_CB_DEFINE(conn_callbacks) =
{
    .connected    = connected,
    .disconnected = disconnected,
};

/*----------------------------------------------------------------------------*/

int ble_gatt_init(void)
{
    int err = 0;

    err = bt_enable(NULL);
    if (0 != err) { printk("[BLE] bt_enable failed (%d)\n", err); return err; }
    trinity_wdt_kick();
    printk("[BLE] Bluetooth enabled\n");

    err = settings_load();
    if (0 != err) { printk("[BLE] Settings load failed (%d)\n", err); }
    trinity_wdt_kick();

    heartbeat_attr = &light_svc.attrs[4];
    k_work_init_delayable(&adv_restart_dwork, restart_advertising);
    k_work_init(&hb_work, hb_work_handler);
    k_work_init(&stats_work, stats_work_handler);

    ble_adv_update();

    err = bt_le_adv_start(BT_LE_ADV_CONN_FAST_1,
                           adv_data, ARRAY_SIZE(adv_data), NULL, 0);
    if (0 != err) { printk("[BLE] Adv start failed (%d)\n", err); return err; }

    printk("[BLE] Advertising active\n");
    trinity_log_event("EVENT: BLE_ADV_START\n");

    last_activity_time = k_uptime_get();

    k_timer_start(&idle_hb_timer,
                  K_SECONDS(IDLE_HEARTBEAT_SEC),
                  K_SECONDS(IDLE_HEARTBEAT_SEC));
    k_timer_start(&stats_timer,
                  K_SECONDS(STATS_INTERVAL_SEC),
                  K_SECONDS(STATS_INTERVAL_SEC));

    return 0;
}
```

## src/ble_gatt.h
```c
/******************************************************************************
 * \file    ble_gatt.h
 * \author  MichaelLynnCSU (https://github.com/MichaelLynnCSU)
 * \date    01-01-2025
 *
 * \brief   BLE GATT service and advertising API for nRF52840 smart light.
 ******************************************************************************/

#ifndef BLE_GATT_H
#define BLE_GATT_H

#include <stdint.h>

/**
 * \brief  Initialise BLE stack, load settings, register GATT service,
 *         start connectable advertisement, arm heartbeat and stats timers.
 *
 * \return 0 on success, negative errno on failure.
 */
int ble_gatt_init(void);

/**
 * \brief  Update manufacturer data payload with current light state and
 *         refresh advertisement atomically via bt_le_adv_update_data().
 */
void ble_adv_update(void);

#endif /* BLE_GATT_H */
```

## src/light_hw.h
```c
#ifndef LIGHT_HW_H
#define LIGHT_HW_H

#include <stdint.h>

/**
 * \brief  Initialise relay GPIO and status LED GPIO.
 * \return 0 on success, negative errno on failure.
 */
int light_hw_init(void);

/**
 * \brief  Drive relay and status LED together.
 * \param  state  1=ON, 0=OFF.
 */
void light_hw_set(uint8_t state);

#endif /* LIGHT_HW_H */
```

## src/light_hw_zephyr.c
```c
/******************************************************************************
 * \file    light_hw_zephyr.c
 * \brief   Zephyr GPIO binding for smart light relay and status LED.
 *
 * \details Implements light_hw.h using Zephyr GPIO API.
 *          All Zephyr driver includes isolated here.
 *          main.c calls through light_hw.h and has no GPIO dependency.
 *          relay_set() in main.c is a thin wrapper over light_hw_set().
 ******************************************************************************/

#include "light_hw.h"
#include "main.h"
#include <zephyr/drivers/gpio.h>
#include <zephyr/devicetree.h>
#include <zephyr/sys/printk.h>
#include <zephyr/logging/log.h>

LOG_MODULE_DECLARE(smartlight_main, LOG_LEVEL_DBG);

#define RELAY_PORT  DT_NODELABEL(gpio0)
#define LIGHT_NODE  DT_ALIAS(led0)

static const struct gpio_dt_spec g_light     = GPIO_DT_SPEC_GET(LIGHT_NODE, gpios);
static const struct device       *g_relay_dev = NULL;

/*----------------------------------------------------------------------------*/

int light_hw_init(void)
{
    g_relay_dev = DEVICE_DT_GET(RELAY_PORT);

    if (!device_is_ready(g_relay_dev))
    {
        printk("[GPIO] Relay device not ready\n");
        return -ENODEV;
    }

    if (gpio_pin_configure(g_relay_dev, RELAY_PIN, GPIO_OUTPUT_INACTIVE))
    {
        printk("[GPIO] Relay pin configure failed\n");
        return -EIO;
    }

    if (!device_is_ready(g_light.port))
    {
        printk("[GPIO] Light LED not ready\n");
        return -ENODEV;
    }

    if (gpio_pin_configure_dt(&g_light, GPIO_OUTPUT_INACTIVE))
    {
        printk("[GPIO] Light LED configure failed\n");
        return -EIO;
    }

    printk("[GPIO] Light/Relay initialized (OFF)\n");
    return 0;
}

/*----------------------------------------------------------------------------*/

void light_hw_set(uint8_t state)
{
    gpio_pin_set(g_relay_dev, RELAY_PIN, state);
    gpio_pin_set_dt(&g_light, state);
}
```

## src/main.h
```c
#ifndef MAIN_H
#define MAIN_H

#include <stdint.h>

#define STATS_INTERVAL_SEC   60
#define IDLE_HEARTBEAT_SEC   240
#define RELAY_PIN            11
#define MFG_COMPANY_ID       0xAD
#define MFG_DATA_SIZE        3
#define MFG_STATE_IDX        1
#define MFG_HEARTBEAT_IDX    2   /**< heartbeat counter, mirrors smart-lock */

/*
 * GATT write payload layout (3 bytes):
 * [0] = state    (0=OFF, 1=ON)
 * [1] = tx_id low byte  (little-endian)
 * [2] = tx_id high byte (little-endian)
 *
 * tx_id is a per-session command counter (RAM only on hub, resets on hub
 * reboot). Correlation key is (MAC + tx_id) within a bounded time window.
 * It is NOT a global unique message ID.
 *
 * Two-phase identity:
 *   tx_id    — generated BEFORE write (command tracking, crosses boundary)
 *   event_id — generated AFTER bus_publish_light() (hub-internal only)
 *
 * Device logs tx_id only. Hub logs tx_id + event_id mapping.
 * If tx_id exists but no event_id appears in hub log → bus failure.
 * If event_id exists but device did not log tx_id → device failure.
 */
#define LIGHT_WRITE_LEN          3
#define LIGHT_WRITE_STATE_IDX    0   /* state byte index                  */
#define LIGHT_WRITE_TX_ID_LO_IDX 1   /* tx_id low byte index              */
#define LIGHT_WRITE_TX_ID_HI_IDX 2   /* tx_id high byte index             */
#define LIGHT_STATE_MAX          1

/**
 * \brief  Drive the relay and status LED to the requested state.
 *         Implemented in main.c, called by ble_gatt.c on GATT write.
 *
 * \param  state  0=OFF, 1=ON.
 */
void relay_set(uint8_t state);

#endif /* MAIN_H */
```

## src/relay.c
```c
#include "light_hw.h"
#include "main.h"

void relay_set(uint8_t state)
{
    light_hw_set(state);
}
```

## src/trinity_boot.c
```c
/******************************************************************************
 * \file trinity_boot.c
 * \brief Trinity boot reason decoder -- nRF52840 Zephyr.
 *
 * \details Centralizes NRF_POWER->RESETREAS decode so all nRF52840 boards
 *          get identical boot reason logging. Depends on trinity_flash.c
 *          via trinity_log_event() only.
 *
 *          main() must read and clear RESETREAS at the very top before
 *          anything else, then call trinity_log_boot_reason() after
 *          trinity_log_init():
 *
 *            uint32_t reset_reason = NRF_POWER->RESETREAS;
 *            NRF_POWER->RESETREAS  = 0xFFFFFFFF;
 *            ...
 *            if (trinity_log_init() == 0) {
 *                trinity_log_boot_reason(reset_reason);
 *            }
 *
 * \note    RESETREAS is a latched OR-history register -- NOT auto-cleared
 *          on reset. Must be read and cleared before any reset can fire,
 *          otherwise stale bits pollute future boot logs.
 *          Combined causes (e.g. DOG|REPOR on first post-flash boot) are
 *          always logged as raw hex alongside the decoded label.
 ******************************************************************************/

#include "trinity_log.h"
#include <stdio.h>

/* nRF52840 RESETREAS bit definitions -- private to this file */
#define TRINITY_RESET_PIN       (1u << 0)  /* RESETPIN */
#define TRINITY_RESET_DOG       (1u << 1)  /* watchdog */
#define TRINITY_RESET_SREQ      (1u << 2)  /* soft reset */
#define TRINITY_RESET_LOCKUP    (1u << 3)  /* CPU lockup */
#define TRINITY_RESET_REPOR     (1u << 16) /* cold POR / OFF */

void trinity_log_boot_reason(uint32_t resetreas)
{
   const char *label   = "NONE";
   char        buf[80] = {0};

   if      (resetreas & TRINITY_RESET_DOG)    { label = "WATCHDOG";   }
   else if (resetreas & TRINITY_RESET_LOCKUP) { label = "LOCKUP";     }
   else if (resetreas & TRINITY_RESET_SREQ)   { label = "SOFT_RESET"; }
   else if (resetreas & TRINITY_RESET_PIN)    { label = "RESET_PIN";  }
   else if (resetreas & TRINITY_RESET_REPOR)  { label = "COLD_POR";   }

   (void)snprintf(buf, sizeof(buf),
                  "EVENT: BOOT | RESETREAS: 0x%08X | REASON: %s\n",
                  resetreas, label);
   trinity_log_event(buf);
}

TRINITY_BOOT_REASON_E trinity_classify_reset(uint32_t resetreas)
{
    if (resetreas & TRINITY_RESET_DOG)    { return TRINITY_BOOT_WATCHDOG;   }
    if (resetreas & TRINITY_RESET_SREQ)   { return TRINITY_BOOT_SOFT_RESET; }
    if (resetreas & TRINITY_RESET_PIN)    { return TRINITY_BOOT_RESET_PIN;  }
    if (resetreas & TRINITY_RESET_REPOR)  { return TRINITY_BOOT_UNKNOWN;    }

    if (g_noinit_guard    == 0xDEADBEEF &&
        g_canary_snapshot == TRINITY_CANARY_BOOTED)
    {
        return TRINITY_BOOT_BROWNOUT;
    }

    return TRINITY_BOOT_COLD_POWER_ON;
}
```

## src/trinity_fault.c
```c
/******************************************************************************
 * \file trinity_fault.c
 * \brief Trinity fault handler -- nRF52840 Zephyr.
 * \board smart-light
 *
 * \details Overrides k_sys_fatal_error_handler(). Captures CFSR/HFSR/
 *          MMFAR/BFAR/PC/LR/SP/cycles and writes to flash via write_panic()
 *          (mutex-free path from trinity_private.h).
 *
 *          Depends on:
 *            trinity_flash.c -- write_panic() via trinity_private.h
 *            trinity_canary.c -- g_init_stage via trinity_private.h
 *
 *          Does NOT call trinity_log_event() -- that acquires g_flash_mutex
 *          which may be held by the crashing thread.
 *
 * \note    k_cycle_get_32() in fault handler (2026-03-25):
 *          k_uptime_get_32() depends on SysTick ISR which may be dead at
 *          fault time. k_cycle_get_32() reads DWT hardware counter directly.
 *
 * \note    g_initialized_magic sentinel (2026-03-25):
 *          write_panic() validates TRINITY_INIT_MAGIC before touching flash
 *          to avoid nested faults if Trinity never completed init.
 ******************************************************************************/

#include "trinity_log.h"
#include "trinity_private.h"
#include <zephyr/kernel.h>
#include <zephyr/fatal.h>
#include <zephyr/sys/reboot.h>
#include <stdio.h>
#include <nrf.h>

#define CRASH_BUF_SIZE  112u

/* ARM Cortex-M4 SCB fault register addresses */
#define SCB_CFSR   (*((volatile uint32_t *)0xE000ED28))
#define SCB_HFSR   (*((volatile uint32_t *)0xE000ED2C))
#define SCB_MMFAR  (*((volatile uint32_t *)0xE000ED34))
#define SCB_BFAR   (*((volatile uint32_t *)0xE000ED38))
#define CFSR_MMARVALID  (1u << 7)
#define CFSR_BFARVALID  (1u << 15)

static const char *reason_to_str(unsigned int reason)
{
   switch (reason)
   {
      case K_ERR_CPU_EXCEPTION:  { return "CPU_EXCEPTION";  }
      case K_ERR_SPURIOUS_IRQ:   { return "SPURIOUS_IRQ";   }
      case K_ERR_STACK_CHK_FAIL: { return "STACK_OVERFLOW"; }
      case K_ERR_KERNEL_OOPS:    { return "KERNEL_OOPS";    }
      case K_ERR_KERNEL_PANIC:   { return "KERNEL_PANIC";   }
      default:                   { return "UNKNOWN";        }
   }
}

/* stage_to_str is only referenced in the BENCH build path below. */
#if defined(CONFIG_TRINITY_MODE_BENCH)
static const char *stage_to_str(uint32_t stage)
{
   switch (stage)
   {
      case TRINITY_STAGE_RESET:     { return "RESET";     }
      case TRINITY_STAGE_GPIO:      { return "GPIO";      }
      case TRINITY_STAGE_BATTERY:   { return "BATTERY";   }
      case TRINITY_STAGE_NVS_INIT:  { return "NVS_INIT";  }
      case TRINITY_STAGE_NVS_LOAD:  { return "NVS_LOAD";  }
      case TRINITY_STAGE_LOG_INIT:  { return "LOG_INIT";  }
      case TRINITY_STAGE_WDT_INIT:  { return "WDT_INIT";  }
      case TRINITY_STAGE_BT_ENABLE: { return "BT_ENABLE"; }
      case TRINITY_STAGE_BT_ADV:    { return "BT_ADV";    }
      case TRINITY_STAGE_MAIN_LOOP: { return "MAIN_LOOP"; }
      default:                      { return "UNKNOWN";   }
   }
}
#endif /* CONFIG_TRINITY_MODE_BENCH */

void k_sys_fatal_error_handler(unsigned int reason,
                                const struct arch_esf *p_esf)
{
   uint32_t cfsr   = SCB_CFSR;
   uint32_t hfsr   = SCB_HFSR;
   uint32_t mmfar  = (cfsr & CFSR_MMARVALID) ? SCB_MMFAR : 0u;
   uint32_t bfar   = (cfsr & CFSR_BFARVALID) ? SCB_BFAR  : 0u;
   uint32_t cycles = k_cycle_get_32();

   char line1[CRASH_BUF_SIZE] = {0};
   char line2[CRASH_BUF_SIZE] = {0};

   if (NULL != p_esf)
   {
      (void)snprintf(line1, sizeof(line1),
                     "EVENT: CRASH | TYPE: %s(%u)"
                     " | PC: 0x%08X | LR: 0x%08X | SP: 0x%08X"
                     " | CYC: %u | STG: 0x%04X\n",
                     reason_to_str(reason), reason,
                     (unsigned int)p_esf->basic.pc,
                     (unsigned int)p_esf->basic.lr,
                     (unsigned int)p_esf,
                     cycles,
                     (unsigned int)g_init_stage);
   }
   else
   {
      (void)snprintf(line1, sizeof(line1),
                     "EVENT: CRASH | TYPE: %s(%u) | PC: unknown"
                     " | CYC: %u | STG: 0x%04X\n",
                     reason_to_str(reason), reason,
                     cycles,
                     (unsigned int)g_init_stage);
   }

   (void)snprintf(line2, sizeof(line2),
                  "EVENT: FAULT | CFSR: 0x%08X | HFSR: 0x%08X"
                  " | MMFAR: 0x%08X | BFAR: 0x%08X\n",
                  cfsr, hfsr, mmfar, bfar);

   /* Original rich diagnostic lines -- unchanged, zero fidelity loss.
    * These carry Zephyr/nRF-specific detail (raw reason string, cycle
    * count, SP, init-stage) that has no place in the architecture-neutral
    * TRINITY_CRASH_RECORD_X, so they stay here, board-owned, exactly as
    * before. */
   write_panic(line1, (uint16_t)strlen(line1));
   write_panic(line2, (uint16_t)strlen(line2));

   /* v2 crash contract: additionally build the canonical cross-board
    * record from the same registers already captured above, and call
    * trinity_crash_store() (trinity_flash.c). This does NOT replace the
    * two lines above -- it writes one further, compact, canonical-format
    * line, giving every board (STM32 + nRF) the same
    * "a TRINITY_CRASH_RECORD_X was stored" entry point, without eroding
    * this board's existing richer diagnostics. */
   TRINITY_CRASH_RECORD_X record = {0};
   record.magic        = TRINITY_CRASH_MAGIC;
   record.version      = TRINITY_CRASH_VERSION;
   record.arch         = TRINITY_ARCH_CORTEX_M;
   record.error        = (K_ERR_STACK_CHK_FAIL == reason) ? eTRINITY_ERR_STACK
                                                            : eTRINITY_ERR_HARDFAULT;
   record.reset_reason = 0u;
   record.pc           = (NULL != p_esf) ? (uint32_t)p_esf->basic.pc : 0u;
   record.lr           = (NULL != p_esf) ? (uint32_t)p_esf->basic.lr : 0u;
   record.arch_data.cortex_m.cfsr  = cfsr;
   record.arch_data.cortex_m.hfsr  = hfsr;
   record.arch_data.cortex_m.mmfar = mmfar;
   record.arch_data.cortex_m.bfar  = bfar;
   trinity_crash_store(&record);

#if defined(CONFIG_TRINITY_MODE_BENCH)
   printk("\n[TRINITY] === FAULT HALT ===\n");
   printk("[TRINITY] %s", line1);
   printk("[TRINITY] %s", line2);
   printk("[TRINITY] STG  : 0x%04X -- %s\n",
          (unsigned int)g_init_stage, stage_to_str(g_init_stage));
   printk("[TRINITY] === HALTED -- attach JLink or read RTT ===\n");
   __disable_irq();
   while (1) {}

#elif defined(CONFIG_TRINITY_MODE_USB)
   k_sleep(K_MSEC(500));
   __disable_irq();
   NVIC_SystemReset();

#else
   __disable_irq();
   NVIC_SystemReset();
#endif
}
```

## src/trinity_flash.c
```c
/******************************************************************************
 * \file trinity_flash.c
 * \brief Trinity flash log -- nRF52840 Zephyr.
 * \board smart-light
 *
 * \details Owns the flash partition, write ring, mutex, and all log I/O.
 *          Depends on trinity_wdt.c (kick during partition scan) and
 *          trinity_canary.c (noinit variables for dump classification).
 *
 *          Three write paths, strict ordering:
 *            write_internal() -- raw flash, no locks, no OS calls.
 *            write_entry()    -- acquires g_flash_mutex. Normal threads only.
 *            write_panic()    -- no mutex. Fault handler only. Exported via
 *                               trinity_private.h for trinity_fault.c.
 *
 * \note    Flash concurrency fix (2026-03-24):
 *          g_flash_mutex serializes all NVMC writes. nRF52840 NVMC is
 *          single-writer. External callers use trinity_flash_lock/unlock()
 *          around settings_save_one() or equivalent.
 *
 * \note    SOC_FLASH_NRF_RADIO_SYNC_TICKER required:
 *          CONFIG_SOC_FLASH_NRF_RADIO_SYNC_NONE disables the flash driver's
 *          internal semaphore, causing nrf_nvmc_ready_check() panics when
 *          Trinity's write_entry() races with BLE stack settings saves.
 *          Confirmed crash: PC=0x5954494E ("NITY"), SP=0x003BA538.
 *          prj.conf must have CONFIG_SOC_FLASH_NRF_RADIO_SYNC_TICKER=y.
 *
 * \note    Deferred dump split (2026-03-30):
 *          trinity_log_dump_previous()          -- bench only, before WDT.
 *          trinity_log_dump_previous_deferred() -- field/USB, after WDT init.
 ******************************************************************************/

#include "trinity_log.h"
#include "trinity_private.h"
#include <zephyr/kernel.h>
#include <zephyr/storage/flash_map.h>
#include <zephyr/drivers/flash.h>
#include <zephyr/init.h>
#include <string.h>
#include <stdio.h>

/******************************** CONSTANTS ***********************************/

#define LOG_PARTITION_ID    FIXED_PARTITION_ID(log_partition)
#define LOG_MAGIC           0xA55A
#define LOG_ENTRY_SIZE      128
#define LOG_PAGE_SIZE       4096
#define LOG_MSG_MAX         (LOG_ENTRY_SIZE - 8)
#define STAT_BUF_SIZE       80u
#define MAX_STAT_THREADS    12
#define TRINITY_INIT_MAGIC  0xBEEFCAFEu

typedef struct
{
   uint16_t magic;
   uint16_t len;
   uint32_t cycles;
   char     msg[LOG_MSG_MAX];
} LOG_ENTRY_T;

#define ENTRY_TOTAL sizeof(LOG_ENTRY_T)

/************************** PRIVATE DATA **************************************/

static struct k_mutex           g_flash_mutex;
static bool                     g_mutex_ready       = false;
static const struct flash_area *g_log_fa             = NULL;
static uint32_t                 g_write_offset       = 0;
static bool                     g_initialized        = false;
static uint32_t                 g_initialized_magic  = 0u;
static bool                     g_part_open          = false;

/************************** PRIVATE FUNCTIONS *********************************/

static int open_partition(void)
{
   int rc = 0;
   if (g_part_open) { return 0; }
   rc = flash_area_open(LOG_PARTITION_ID, &g_log_fa);
   if (0 == rc) { g_part_open = true; }
   return rc;
}

static void close_partition(void)
{
   if (g_part_open)
   {
      flash_area_close(g_log_fa);
      g_part_open = false;
      g_log_fa    = NULL;
   }
}

static uint32_t find_write_offset(void)
{
   uint32_t    total_entries = 0;
   uint32_t    offset        = 0;
   uint32_t    i             = 0;
   LOG_ENTRY_T entry;

   if (!g_part_open) { return 0; }

   total_entries = g_log_fa->fa_size / ENTRY_TOTAL;
   for (i = 0; i < total_entries; i++)
   {
      trinity_wdt_kick();
      offset = i * ENTRY_TOTAL;
      (void)flash_area_read(g_log_fa, offset, &entry, sizeof(entry));
      if (LOG_MAGIC != entry.magic) { return offset; }
   }
   return 0;
}

static void write_internal(const char *p_msg, uint16_t len)
{
   uint32_t    page_start = 0;
   LOG_ENTRY_T entry;

   if (!g_part_open || 0u == len) { return; }

   (void)memset(&entry, 0xFF, sizeof(entry));
   entry.magic  = LOG_MAGIC;
   entry.cycles = k_cycle_get_32();
   entry.len    = MIN(len, (uint16_t)(sizeof(entry.msg) - 1u));
   (void)memcpy(entry.msg, p_msg, entry.len);
   entry.msg[entry.len] = '\0';

   page_start = (g_write_offset / LOG_PAGE_SIZE) * LOG_PAGE_SIZE;
   if (g_write_offset == page_start)
   {
      (void)flash_area_flatten(g_log_fa, page_start, LOG_PAGE_SIZE);
   }
   (void)flash_area_write(g_log_fa, g_write_offset, &entry, sizeof(entry));

   g_write_offset += ENTRY_TOTAL;
   if ((g_write_offset + ENTRY_TOTAL) > g_log_fa->fa_size)
   {
      g_write_offset = 0u;
   }
}

static void write_entry(const char *p_msg, uint16_t len)
{
   if (!g_initialized || !g_part_open || 0u == len) { return; }
   k_mutex_lock(&g_flash_mutex, K_FOREVER);
   write_internal(p_msg, len);
   k_mutex_unlock(&g_flash_mutex);
}

/* Exported via trinity_private.h for trinity_fault.c only. */
void write_panic(const char *p_msg, uint16_t len)
{
   if (TRINITY_INIT_MAGIC != g_initialized_magic) { return; }
   if (!g_part_open || 0u == len)                 { return; }
   write_internal(p_msg, len);
}

/* Trinity crash contract (v2) -- writes one compact, canonical-format
 * line built purely from TRINITY_CRASH_RECORD_X's fields. This is
 * additive to trinity_fault.c's own richer diagnostic lines (which carry
 * Zephyr-specific detail -- raw reason string, cycle count, SP, init
 * stage -- that has no place in the architecture-neutral record); it
 * does not replace them. Uses write_panic()'s same lock-free fault-context
 * path -- this is only ever called from k_sys_fatal_error_handler(). */
void trinity_crash_store(TRINITY_CRASH_RECORD_X *p_record)
{
   char buf[192] = {0};  /* worst-case snprintf output: ~165B per
                            * -Wformat-truncation (2x %u + 6x 0x%%08X +
                            * literals), rounded up with margin. NOT tied
                            * to trinity_fault.c's CRASH_BUF_SIZE (112) --
                            * that size fit the ORIGINAL line1/line2
                            * strings, not this longer canonical-record
                            * line. */

   if (NULL == p_record) { return; }

   (void)snprintf(buf, sizeof(buf),
                  "EVENT: TRINITY_CRASH_RECORD | ARCH: %u | ERR: %u"
                  " | PC: 0x%08X | LR: 0x%08X | CFSR: 0x%08X | HFSR: 0x%08X"
                  " | MMFAR: 0x%08X | BFAR: 0x%08X\n",
                  (unsigned int)p_record->arch,
                  (unsigned int)p_record->error,
                  (unsigned int)p_record->pc,
                  (unsigned int)p_record->lr,
                  (unsigned int)p_record->arch_data.cortex_m.cfsr,
                  (unsigned int)p_record->arch_data.cortex_m.hfsr,
                  (unsigned int)p_record->arch_data.cortex_m.mmfar,
                  (unsigned int)p_record->arch_data.cortex_m.bfar);

   write_panic(buf, (uint16_t)strlen(buf));
}

/************************** FLASH MUTEX API ***********************************/

void trinity_flash_lock(void)
{
   if (g_mutex_ready) { k_mutex_lock(&g_flash_mutex, K_FOREVER); }
}

void trinity_flash_unlock(void)
{
   if (g_mutex_ready) { k_mutex_unlock(&g_flash_mutex); }
}

/************************** DUMP CORE *****************************************/

static const char *stage_to_str(uint32_t stage)
{
   switch (stage)
   {
      case TRINITY_STAGE_RESET:     { return "RESET (cookie not yet written)";           }
      case TRINITY_STAGE_GPIO:      { return "GPIO      -- about to init GPIO/PWM/LED";  }
      case TRINITY_STAGE_BATTERY:   { return "BATTERY   -- about to call battery_init()"; }
      case TRINITY_STAGE_NVS_INIT:  { return "NVS_INIT  -- about to settings_subsys_init()"; }
      case TRINITY_STAGE_NVS_LOAD:  { return "NVS_LOAD  -- about to load settings";     }
      case TRINITY_STAGE_LOG_INIT:  { return "LOG_INIT  -- about to trinity_log_init()"; }
      case TRINITY_STAGE_WDT_INIT:  { return "WDT_INIT  -- about to trinity_wdt_init()"; }
      case TRINITY_STAGE_BT_ENABLE: { return "BT_ENABLE -- about to bt_enable()";       }
      case TRINITY_STAGE_BT_ADV:    { return "BT_ADV    -- about to bt_le_adv_start()"; }
      case TRINITY_STAGE_MAIN_LOOP: { return "MAIN_LOOP -- entered main while(1)";      }
      default:                      { return "UNKNOWN stage value";                     }
   }
}

static void trinity_log_dump_core(void)
{
   uint32_t    total_entries = 0;
   uint32_t    i             = 0;
   bool        found_any     = false;
   LOG_ENTRY_T entry;

   printk("[TRINITY] BUILD: %s | MODE: %s\n",
          CONFIG_TRINITY_MODE_STR,
          IS_ENABLED(CONFIG_TRINITY_MODE_BENCH) ? "BENCH" :
          IS_ENABLED(CONFIG_TRINITY_MODE_USB)   ? "USB"   : "FIELD");

   if (g_noinit_guard != 0xDEADBEEF)
   {
      printk("[TRINITY] NOINIT_GUARD: 0x%08X (first boot or BSS bleed)\n",
             g_noinit_guard);
   }
   g_noinit_guard = 0xDEADBEEF;

   uint32_t canary = g_canary_snapshot;
   uint32_t stage  = g_init_stage;
   g_canary_snapshot = 0U;
   g_init_stage      = TRINITY_STAGE_RESET;

   if (TRINITY_CANARY_ALIVE == canary)
   {
      printk("[TRINITY] EVENT: BOOT | REASON: PRE_INIT_CRASH\n");
      printk("[TRINITY] NOTE: Previous boot crashed before Trinity init.\n");
      printk("[TRINITY] NOTE: ISR stack overflow or early SYS_INIT fault.\n");
      printk("[TRINITY] NOTE: No flash log available for that crash.\n");
      printk("[TRINITY] STAGE: 0x%04X -- %s\n", stage, stage_to_str(stage));
   }
   else if (TRINITY_CANARY_BOOTED == canary)
   {
      printk("[TRINITY] EVENT: BOOT | REASON: POST_INIT_CRASH\n");
      printk("[TRINITY] NOTE: Previous boot crashed after Trinity init.\n");
      printk("[TRINITY] NOTE: Flash log should contain fault details.\n");
      printk("[TRINITY] STAGE: 0x%04X -- %s\n", stage, stage_to_str(stage));
   }
   else
   {
      printk("[TRINITY] NOTE: Cold boot or first power-on detected.\n");
   }

   if (0 != open_partition())
   {
      printk("[TRINITY] Cannot open log partition\n");
      return;
   }

   total_entries = g_log_fa->fa_size / ENTRY_TOTAL;
   printk("=== Previous Session Logs ===\n");

   for (i = 0; i < total_entries; i++)
   {
      (void)flash_area_read(g_log_fa, i * ENTRY_TOTAL, &entry, sizeof(entry));
      if ((LOG_MAGIC == entry.magic) &&
          (0 < entry.len) &&
          (entry.len < sizeof(entry.msg)))
      {
         entry.msg[entry.len] = '\0';
         printk("[%u cyc] %s", entry.cycles, entry.msg);
         found_any = true;
      }
   }

   if (!found_any) { printk("  (no logs found)\n"); }
   printk("=== End of Previous Logs ===\n");
   close_partition();
}

void trinity_log_dump_previous(void)
{
#if defined(CONFIG_TRINITY_MODE_BENCH)
   trinity_log_dump_core();
#endif
}

void trinity_log_dump_previous_deferred(void)
{
#if !defined(CONFIG_TRINITY_MODE_BENCH)
   trinity_log_dump_core();
#endif
}

/************************** PUBLIC FLASH LOG API ******************************/

int trinity_log_erase(void)
{
   int rc = 0;
   if (!g_part_open)
   {
      rc = open_partition();
      if (0 != rc) { return -EIO; }
   }
   rc             = flash_area_flatten(g_log_fa, 0, g_log_fa->fa_size);
   g_write_offset = 0;
   return rc;
}

void trinity_log_event(const char *p_msg)
{
   if (!g_initialized) { return; }
   write_entry(p_msg, (uint16_t)strlen(p_msg));
   printk("[TRINITY] %s\n", p_msg);
}

int trinity_log_init(void)
{
   int rc = 0;

   k_mutex_init(&g_flash_mutex);
   g_mutex_ready = true;

   rc = open_partition();
   if (0 != rc) { return -EIO; }

   g_write_offset      = find_write_offset();
   g_initialized       = true;
   g_initialized_magic = TRINITY_INIT_MAGIC;

   trinity_canary_set_booted();
   trinity_log_stats_init();

   return 0;
}
```
