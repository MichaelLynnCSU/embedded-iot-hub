#include "ili9341.h"
#include <string.h>

/* ===== SPI handle ===== */
static SPI_HandleTypeDef *ili_spi;

/* ===== 5x7 font ===== */
static const uint8_t font5x7[][5] = {
    {0x00,0x00,0x00,0x00,0x00}, /* 0x20 space */
    {0x00,0x00,0x5F,0x00,0x00}, /* 0x21 ! */
    {0x00,0x07,0x00,0x07,0x00}, /* 0x22 " */
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    {0x44,0x64,0x54,0x4C,0x44}, /* 0x7A z */
};

/* ===== Low level SPI ===== */
static void ILI9341_SendCmd(uint8_t cmd)
{
    ILI9341_DC_LOW();
    ILI9341_CS_LOW();
    HAL_SPI_Transmit(ili_spi, &cmd, 1, 100);
    ILI9341_CS_HIGH();
}

static void ILI9341_SendData(uint8_t data)
{
    ILI9341_DC_HIGH();
    ILI9341_CS_LOW();
    HAL_SPI_Transmit(ili_spi, &data, 1, 100);
    ILI9341_CS_HIGH();
}

static void ILI9341_SendData16(uint16_t data)
{
    uint8_t buf[2] = { data >> 8, data & 0xFF };
    ILI9341_DC_HIGH();
    ILI9341_CS_LOW();
    HAL_SPI_Transmit(ili_spi, buf, 2, 100);
    ILI9341_CS_HIGH();
}

/* ===== Set draw window ===== */
static void ILI9341_SetWindow(uint16_t x0, uint16_t y0, uint16_t x1, uint16_t y1)
{
    ILI9341_SendCmd(0x2A); /* Column address set */
    ILI9341_SendData(x0 >> 8);
    ILI9341_SendData(x0 & 0xFF);
    ILI9341_SendData(x1 >> 8);
    ILI9341_SendData(x1 & 0xFF);

    ILI9341_SendCmd(0x2B); /* Row address set */
    ILI9341_SendData(y0 >> 8);
    ILI9341_SendData(y0 & 0xFF);
    ILI9341_SendData(y1 >> 8);
    ILI9341_SendData(y1 & 0xFF);

    ILI9341_SendCmd(0x2C); /* Memory write */
}

/* ===== Init sequence ===== */
void ILI9341_Init(SPI_HandleTypeDef *hspi)
{
    ili_spi = hspi;

    /* Hardware reset */
    ILI9341_RST_LOW();
    HAL_Delay(10);
    ILI9341_RST_HIGH();
    HAL_Delay(120);

    ILI9341_SendCmd(0x01); /* Software reset */
    HAL_Delay(150);

    ILI9341_SendCmd(0xCB); /* Power control A */
    ILI9341_SendData(0x39); ILI9341_SendData(0x2C); ILI9341_SendData(0x00);
    ILI9341_SendData(0x34); ILI9341_SendData(0x02);

    ILI9341_SendCmd(0xCF); /* Power control B */
    ILI9341_SendData(0x00); ILI9341_SendData(0xC1); ILI9341_SendData(0x30);

    ILI9341_SendCmd(0xE8); /* Driver timing control A */
    ILI9341_SendData(0x85); ILI9341_SendData(0x00); ILI9341_SendData(0x78);

    ILI9341_SendCmd(0xEA); /* Driver timing control B */
    ILI9341_SendData(0x00); ILI9341_SendData(0x00);

    ILI9341_SendCmd(0xED); /* Power on sequence */
    ILI9341_SendData(0x64); ILI9341_SendData(0x03);
    ILI9341_SendData(0x12); ILI9341_SendData(0x81);

    ILI9341_SendCmd(0xF7); /* Pump ratio control */
    ILI9341_SendData(0x20);

    ILI9341_SendCmd(0xC0); /* Power control 1 */
    ILI9341_SendData(0x23);

    ILI9341_SendCmd(0xC1); /* Power control 2 */
    ILI9341_SendData(0x10);

    ILI9341_SendCmd(0xC5); /* VCOM control 1 */
    ILI9341_SendData(0x3E); ILI9341_SendData(0x28);

    ILI9341_SendCmd(0xC7); /* VCOM control 2 */
    ILI9341_SendData(0x86);

    ILI9341_SendCmd(0x36); /* Memory access control */
    ILI9341_SendData(0x40); /* Portrait mode */

    ILI9341_SendCmd(0x3A); /* Pixel format */
    ILI9341_SendData(0x55); /* 16 bit RGB565 */

    ILI9341_SendCmd(0xB1); /* Frame rate */
    ILI9341_SendData(0x00); ILI9341_SendData(0x18);

    ILI9341_SendCmd(0xB6); /* Display function control */
    ILI9341_SendData(0x08); ILI9341_SendData(0x82); ILI9341_SendData(0x27);

    ILI9341_SendCmd(0xF2); /* 3G gamma disable */
    ILI9341_SendData(0x00);

    ILI9341_SendCmd(0x26); /* Gamma curve */
    ILI9341_SendData(0x01);

    ILI9341_SendCmd(0xE0); /* Positive gamma */
    ILI9341_SendData(0x0F); ILI9341_SendData(0x31); ILI9341_SendData(0x2B);
    ILI9341_SendData(0x0C); ILI9341_SendData(0x0E); ILI9341_SendData(0x08);
    ILI9341_SendData(0x4E); ILI9341_SendData(0xF1); ILI9341_SendData(0x37);
    ILI9341_SendData(0x07); ILI9341_SendData(0x10); ILI9341_SendData(0x03);
    ILI9341_SendData(0x0E); ILI9341_SendData(0x09); ILI9341_SendData(0x00);

    ILI9341_SendCmd(0xE1); /* Negative gamma */
    ILI9341_SendData(0x00); ILI9341_SendData(0x0E); ILI9341_SendData(0x14);
    ILI9341_SendData(0x03); ILI9341_SendData(0x11); ILI9341_SendData(0x07);
    ILI9341_SendData(0x31); ILI9341_SendData(0xC1); ILI9341_SendData(0x48);
    ILI9341_SendData(0x08); ILI9341_SendData(0x0F); ILI9341_SendData(0x0C);
    ILI9341_SendData(0x31); ILI9341_SendData(0x36); ILI9341_SendData(0x0F);

    ILI9341_SendCmd(0x11); /* Sleep out */
    HAL_Delay(120);

    ILI9341_SendCmd(0x29); /* Display on */
    HAL_Delay(20);
}

/* ===== Drawing functions ===== */
void ILI9341_DrawPixel(uint16_t x, uint16_t y, uint16_t color)
{
    ILI9341_SetWindow(x, y, x, y);
    ILI9341_SendData16(color);
}

void ILI9341_FillRect(uint16_t x, uint16_t y, uint16_t w, uint16_t h, uint16_t color)
{
    ILI9341_SetWindow(x, y, x + w - 1, y + h - 1);
    uint8_t buf[2] = { color >> 8, color & 0xFF };
    ILI9341_DC_HIGH();
    ILI9341_CS_LOW();
    for (uint32_t i = 0; i < (uint32_t)w * h; i++) {
        HAL_SPI_Transmit(ili_spi, buf, 2, 100);
    }
    ILI9341_CS_HIGH();
}

void ILI9341_FillScreen(uint16_t color)
{
    ILI9341_FillRect(0, 0, ILI9341_WIDTH, ILI9341_HEIGHT, color);
}

void ILI9341_DrawChar(uint16_t x, uint16_t y, char c, uint16_t fg, uint16_t bg, uint8_t size)
{
    if (c < 0x20 || c > 0x7A) c = 0x20;
    const uint8_t *glyph = font5x7[c - 0x20];

    for (uint8_t col = 0; col < 5; col++) {
        uint8_t line = glyph[col];
        for (uint8_t row = 0; row < 7; row++) {
            uint16_t color = (line & (1 << row)) ? fg : bg;
            if (size == 1) {
                ILI9341_DrawPixel(x + col, y + row, color);
            } else {
                ILI9341_FillRect(x + col * size, y + row * size, size, size, color);
            }
        }
    }
}

void ILI9341_DrawString(uint16_t x, uint16_t y, const char *str, uint16_t fg, uint16_t bg, uint8_t size)
{
    uint16_t cur_x = x;
    while (*str) {
        ILI9341_DrawChar(cur_x, y, *str++, fg, bg, size);
        cur_x += (5 + 1) * size;
    }
}

void ILI9341_DrawBitmap(uint16_t x, uint16_t y, uint16_t w, uint16_t h, uint16_t *data)
{
    ILI9341_SetWindow(x, y, x + w - 1, y + h - 1);
    ILI9341_CS_LOW();
    ILI9341_DC_HIGH();
    HAL_SPI_Transmit(ili_spi, (uint8_t *)data, w * h * 2, HAL_MAX_DELAY);
    ILI9341_CS_HIGH();
}




